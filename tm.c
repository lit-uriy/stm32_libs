/**************************************************************************
*================== НПО "Сибирский арсенал" ==============================*
***************************************************************************
* 	
* Заголовок:			функции TM
* Имя файла:			tm.с
*  
* Версия программы:		1.0
* Компилятор:			WinAVR (avr-gcc rev3.3.1)
* Микросхема:			ATmega8535
* Частота:				6.000МГц
* Дата начала:			09.10.2006	
* Последнее обновление:	09.10.2006
* Автор:				Литкевич Юрий Иванович
* Support E-mail:		lit-uriy@yandex.ru
*
* Описание:				
* 							
* 							
* 							
* Log:
* 
*
*
****************************************************************************/
#include <avr/io.h>
//#include <avr/signal.h>
#include <avr/interrupt.h>

#include "global.h"
#include "tm.h"
#include "tmr2.h"


/*********************************************************
*               Функция обнаружения TM	
*---------------------------------------------------------
*                    
**********************************************************/ 
byte TMReset(void) // возврат "0"-устройство присутствует
{

	asm("cli");
		// должна быть "1"
		if (!TM) {asm("sei");return TM_SHRT_CRT;}	
		//выставляем "Reset pulse"
		TM_LOW;
	asm("sei");		
	
  	delay_TM(T_RSTL);//~460us
	
	asm("cli");
		//снимаем "Reset pulse"
		TM_RELEASE;	
	asm("sei");		
	
	//ждем возврата линии "0"->"1"
	delay_TM(T_RELS);

	asm("cli");
		if (!TM) {asm("sei");	return TM_SHRT_CRT;}// должна быть "1"
	asm("sei");
	
	//ждем фронт "1"->"0"
    delay_TM(T_SLOT);
	
	asm("cli");	
		if (TM) {asm("sei");return TM_ABSNT;}	// нет устройства
	asm("sei");
	
	//ждем завершения "Presence pulse" "0"->"1"
    delay_TM(T_PRES);
	if (!TM) {return TM_SHRT_CRT;} 	// должна быть "1"
	

	//"Presence pulse" завершен
	
	return TM_PRESNC; //TM присутствует


}

/*********************************************************
*           Функция приема/передачи байта в/из TM	
*---------------------------------------------------------
*                    
**********************************************************/
byte TMByte(byte* x) // x=0xFF - принять байт из ТМ, иначе отправить в ТМ
{		
unsigned char j;


    for(j=0;j<8;j++)
    {
		asm("cli");
			// должна быть "1"
			if (!TM) {asm("sei"); return TM_SHRT_CRT;}	
			//выставляем "Синхрофронт"
			TM_LOW;
			//asm("sei");
			delay_TM(T_10U);
			//asm("cli");
			if((*x) & 0x01) TM_RELEASE;
			(*x)>>=1;
			//asm("sei");	
			delay_TM(T_10U);
			//asm("cli");
			if (TM) (*x) |=0x80;
		asm("sei");
		
        delay_TM(T_SLOT-(2*T_10U));
		
        TM_RELEASE;
		
        delay_TM(2*T_10U);
    }
    return 0;
}
